## esp32c3_spi_display/sdkconfig.defaults
```kconfig
# ESP32-C3 Configuration
CONFIG_IDF_TARGET="esp32c3"

# SPI Configuration
CONFIG_SPI_MASTER_IN_IRAM=y
CONFIG_SPI_MASTER_ISR_IN_IRAM=y

# Memory Configuration
CONFIG_SPIRAM_SUPPORT=n

# FreeRTOS Configuration
CONFIG_FREERTOS_HZ=1000
```

## esp32c3_wifi_display/sdkconfig.defaults
```kconfig
# ESP32-C3 specific
CONFIG_IDF_TARGET="esp32c3"

# SPI Configuration
CONFIG_SPI_MASTER_IN_IRAM=y
CONFIG_SPI_MASTER_ISR_IN_IRAM=y

# WiFi Configuration
CONFIG_ESP_WIFI_STATIC_RX_BUFFER_NUM=10
CONFIG_ESP_WIFI_DYNAMIC_RX_BUFFER_NUM=32
CONFIG_ESP_WIFI_DYNAMIC_TX_BUFFER_NUM=32
CONFIG_ESP_WIFI_AMPDU_TX_ENABLED=y
CONFIG_ESP_WIFI_AMPDU_RX_ENABLED=y

# HTTP Server
CONFIG_HTTPD_MAX_REQ_HDR_LEN=1024
CONFIG_HTTPD_MAX_URI_LEN=512

# Partition
CONFIG_PARTITION_TABLE_SINGLE_APP_LARGE=y
```

## esp32c3_wifi_led_control/main/Kconfig.projbuild
```kconfig
menu "WiFi LED Control Configuration"

    config ESP_WIFI_SSID
        string "WiFi SSID"
        default "lulumi_ap"
        help
            SSID (network name) to connect to.

    config ESP_WIFI_PASSWORD
        string "WiFi Password"
        default "1978120505"
        help
            WiFi password (WPA or WPA2).

    config ESP_MAXIMUM_RETRY
        int "Maximum retry"
        default 5
        help
            Set the Maximum retry to avoid station reconnecting to the AP unlimited when the AP is really inexistent.

    config LED_GPIO
        int "LED GPIO number"
        range 0 21
        default 8
        help
            GPIO number for LED control (inverted logic: LOW=ON).

    config LED_ON_TIME
        int "LED ON time in ms"
        range 10 5000
        default 200
        help
            LED ON duration when blinking (milliseconds).

    config LED_OFF_TIME
        int "LED OFF time in ms"
        range 10 5000
        default 800
        help
            LED OFF duration when blinking (milliseconds).

endmenu
```
